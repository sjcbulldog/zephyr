## drivers/wifi/infineon/Kconfig.airoc
```kconfig
# Copyright (c) 2025
# SPDX-License-Identifier: Apache-2.0

# Native Infineon AIROC Wi-Fi driver. It is sourced from drivers/wifi/Kconfig
# and enabled automatically when a board has an SDIO "infineon,airoc-wifi" node.

menuconfig WIFI_AIROC
	bool "Infineon AIROC Wi-Fi support"
	depends on DT_HAS_INFINEON_AIROC_WIFI_ENABLED
	depends on $(dt_compat_on_bus,$(DT_COMPAT_INFINEON_AIROC_WIFI),sd) || \
		   $(dt_compat_on_bus,$(DT_COMPAT_INFINEON_AIROC_WIFI),spi)
	default y
	select NET_L2_ETHERNET
	select NET_L2_WIFI_MGMT
	select WIFI_USE_NATIVE_NETWORKING
	select NET_L2_ETHERNET_EXTRA_TX_PKT_HEADROOM
	select GPIO
	select EVENTS
	help
	  Native Zephyr driver for Infineon AIROC Wi-Fi 5 and Wi-Fi 6
	  devices on SDIO (zero-copy) or gSPI. The device is chosen with the
	  AIROC_PART and module choices below (CYW43438 and CYW43022 are not
	  supported).

if WIFI_AIROC

config WIFI_AIROC_BUS_SDIO
	def_bool $(dt_compat_on_bus,$(DT_COMPAT_INFINEON_AIROC_WIFI),sd)
	select SDHC
	select SDIO_STACK

config WIFI_AIROC_BUS_SPI
	def_bool $(dt_compat_on_bus,$(DT_COMPAT_INFINEON_AIROC_WIFI),spi)
	select SPI

config WIFI_AIROC_THREAD_STACK_SIZE
	int "Driver thread stack size"
	default 4096
	help
	  Stack of the single driver thread that services SDIO interrupts,
	  receives frames and transmits queued packets.

config WIFI_AIROC_THREAD_PRIORITY
	int "Driver thread priority"
	default 5
	help
	  Cooperative priority of the driver thread.

config WIFI_AIROC_TX_QUEUE_DEPTH
	int "Packets queued per access category"
	default 16
	range 2 128
	help
	  Maximum packets waiting for firmware credit in each of the four
	  access-category queues. Excess packets are dropped with a counter.

config WIFI_AIROC_RX_BUF_SIZE
	int "Maximum receive frame size in bytes"
	default 1664
	range 1600 8192
	help
	  Largest SDPCM frame accepted. Must cover SDPCM + BDC headers, an
	  Ethernet frame, plus bus alignment padding. Larger frames are
	  discarded and counted.

config WIFI_AIROC_IOCTL_TIMEOUT_MS
	int "Control (ioctl/iovar) timeout"
	default 5000

config WIFI_AIROC_JOIN_TIMEOUT_MS
	int "Association timeout"
	default 9000

config WIFI_AIROC_AP
	bool "Soft AP mode (untested on hardware)"

config WIFI_AIROC_WPA3_SAE
	bool "WPA3-SAE (firmware-resident supplicant)"
	default y

module = WIFI_AIROC
module-str = AIROC Wi-Fi
source "subsys/logging/Kconfig.template.log_config"

# ---- Device selection -------------------------------------------------------
# The board names the connectivity device with the same AIROC_PART and module
# choices used by the Bluetooth driver, so one board setting drives both.
# CMakeLists.txt maps the selection to the firmware, CLM and NVRAM files and
# links only those into the image.

config WIFI_AIROC_CUSTOM_BLOBS
	bool "Custom device/module blobs"
	help
	  Supply your own firmware, CLM and NVRAM instead of the ones selected
	  by the AIROC part and module. Set the three paths below.

if WIFI_AIROC_CUSTOM_BLOBS

config WIFI_AIROC_CUSTOM_FW_PATH
	string "Path to firmware image"

config WIFI_AIROC_CUSTOM_CLM_PATH
	string "Path to CLM blob"

config WIFI_AIROC_CUSTOM_NVRAM_PATH
	string "Path to NVRAM text file"

endif # WIFI_AIROC_CUSTOM_BLOBS

config WIFI_AIROC_MFG_FIRMWARE
	bool "Manufacturing-test firmware"
	depends on !WIFI_AIROC_CUSTOM_BLOBS
	help
	  Link the manufacturing-test firmware and CLM instead of the production
	  images. Never enable this for normal use.

config WIFI_AIROC_CHIP_ID
	int
	default 43430 if CYW4343W
	default 43439 if CYW43439
	default 43012 if CYW43012
	default 17267 if CYW4373
	default 55500 if CYW55500
	default 55560 if CYW55572
	default 0
	help
	  Chip ID the selected part reports. The boot code refuses to download
	  firmware when the detected chip differs. 0 disables the check (custom
	  blobs).

choice AIROC_PART
	prompt "Select AIROC part"
	depends on !WIFI_AIROC_CUSTOM_BLOBS

config CYW4343W
	bool "CYW4343W"

config CYW4373
	bool "CYW4373"

config CYW43012
	bool "CYW43012"

config CYW43439
	bool "CYW43439"

config CYW55500
	bool "CYW55500"

config CYW55572
	bool "CYW55572"

endchoice

choice CYW43012_MODULE
	prompt "Select CYW43012 module"
	depends on CYW43012 && !WIFI_AIROC_CUSTOM_BLOBS

config CYW43012_MURATA_1LV
	bool "MURATA-1LV"
endchoice

choice CYW4343W_MODULE
	prompt "Select CYW4343W module"
	depends on CYW4343W && !WIFI_AIROC_CUSTOM_BLOBS

config CYW4343W_MURATA_1DX
	bool "MURATA-1DX"
endchoice

choice CYW4373_MODULE
	prompt "Select CYW4373 module"
	depends on CYW4373 && !WIFI_AIROC_CUSTOM_BLOBS

config CYW4373_MURATA_2AE
	bool "CYW4373_MURATA_2AE"

config CYW4373_MURATA_2BC
	bool "CYW4373_MURATA_2BC"

config CYW4373_STERLING_LWB5PLUS
	bool "STERLING-LWB5plus"
endchoice

choice CYW43439_MODULE
	prompt "Select CYW43439 module"
	depends on CYW43439 && !WIFI_AIROC_CUSTOM_BLOBS

config CYW43439_MURATA_1YN
	bool "MURATA_1YN"

config CYW43439_STERLING_LWBPLUS
	bool "STERLING-LWBplus"
endchoice

choice CYW55500_MODULE
	prompt "Select CYW55500 module"
	depends on CYW55500 && !WIFI_AIROC_CUSTOM_BLOBS

config CYW955513SDM2WLIPA_SM
	bool "CYW955513SDM2WLIPA_SM"

config CYW55513IUBG_SM
	bool "CYW55513IUBG_SM"

config CYW55513_MURATA_2FY_SM
	bool "CYW55513 MURATA-2FY (SM)"

config CYW55513_MOD_PSE84_SOM
	bool "CYW55513_MOD_PSE84_SOM"
endchoice

choice CYW55572_MODULE
	prompt "Select CYW55572 module"
	depends on CYW55572 && !WIFI_AIROC_CUSTOM_BLOBS

config CYW955573M2IPA1_SM
	bool "CYW955573M2IPA1_SM"
endchoice

endif # WIFI_AIROC
```
